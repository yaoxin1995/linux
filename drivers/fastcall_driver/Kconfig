## drivers/fastcall_driver/Kconfig
```kconfig
config FASTCALL_DRIVER
	tristate "Driver with example fastcalls"
	help
	  Enable the fastcalL driver, which adds some example fastcalls
	  for testing and benchmarking the fastcall mechanism.
	  TODO: the driver should "depends on FASTCALL" config
```
